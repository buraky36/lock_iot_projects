## myProjects/2_Smart_Gateway/Firmware/sdkconfig.defaults
```kconfig
CONFIG_ESP_TLS_INSECURE=y
CONFIG_ESP_TLS_SKIP_SERVER_CERT_VERIFY=y
CONFIG_ESP_MAIN_TASK_STACK_SIZE=10240
CONFIG_BT_NIMBLE_MAX_CONNECTIONS=4
CONFIG_NIMBLE_MAX_CONNECTIONS=4
CONFIG_BT_NIMBLE_MAX_BONDS=3
CONFIG_NIMBLE_MAX_BONDS=3
CONFIG_BT_NIMBLE_MAX_CCCDS=8
CONFIG_NIMBLE_MAX_CCCDS=8
```
